## app-build/Kconfig.board
```kconfig
# Copyright (c) 2022 Nordic Semiconductor ASA
# SPDX-License-Identifier: Apache-2.0

config BOARD_HACKATHON2
	bool "hackathon2"
	depends on SOC_NRF9160_SICA
```

## app-build/Kconfig.defconfig
```kconfig
# Copyright (c) 2022 Nordic Semiconductor ASA
# SPDX-License-Identifier: Apache-2.0

if BOARD_HACKATHON2

config BOARD
	default "hackathon2"


endif
```
